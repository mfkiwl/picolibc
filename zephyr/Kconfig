## zephyr/Kconfig
```kconfig
# Copyright © 2021 Amazon.com, Inc. or its affiliates.
# SPDX-License-Identifier: Apache-2.0

config PICOLIBC_MODULE
	bool "picolibc support"
	select LIBC_ERRNO
	select THREAD_LOCAL_STORAGE if ARCH_HAS_THREAD_LOCAL_STORAGE
	help
	  This option enables picolibc
```
